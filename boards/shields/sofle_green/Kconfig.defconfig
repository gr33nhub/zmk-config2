## boards/shields/sofle_green/Kconfig.defconfig
```kconfig
if SHIELD_SOFLE_GREN_LEFT

# Name must be less than 16 characters long!
config ZMK_KEYBOARD_NAME
    default "Sofle green"

config ZMK_SPLIT_ROLE_CENTRAL
    default y

config ZMK_SPLIT_BLE_CENTRAL_PERIPHERALS
  default 1

config BT_MAX_CONN
  default 6

config BT_MAX_PAIRED
  default 6

endif

if SHIELD_SOFLE_GREN_LEFT || SHIELD_SOFLE_GREN_RIGHT

config ZMK_SPLIT
    default y

endif
```

## boards/shields/sofle_green/Kconfig.shield
```kconfig
config SHIELD_SOFLE_GREEN_LEFT
    def_bool $(shields_list_contains,sofle_green_left)

config SHIELD_SOFLE_GREEN_RIGHT
    def_bool $(shields_list_contains,sofle_green_right)
```

## boards/shields/sofle_gren/Kconfig.shield
```kconfig
config SHIELD_SOFLE_GREN_LEFT
    def_bool $(shields_list_contains,sofle_gren_left)

config SHIELD_SOFLE_GREN_RIGHT
    def_bool $(shields_list_contains,sofle_gren_right)
```
